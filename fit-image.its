## fit-image.its
```
/*
 * Simple U-Boot uImage source file containing a single kernel, ramdisk and FDT blob
 */

/dts-v1/;

/ {
	description = "Simple image with single Linux kernel, ramdisk and FDT blob";
	#address-cells = <1>;

	images {
		kernel@1 {
			description = "Dragonboard snappy kernel";
			data = /incbin/("./kernel.img");
			type = "kernel";
			arch = "arm64";
			os = "linux";
			compression = "none";
			load = <0x80080000>;
			entry = <0x80080000>;
                        hash@1 {
                                algo = "crc32";
                        };
                        hash@2 {
                                algo = "sha1";
                        };
		};

		ramdisk@1 {
			description = "Ubuntu snappy ramdisk";
			data = /incbin/("./initrd.img");
			type = "ramdisk";
			arch = "arm64";
			os = "linux";
			compression = "gzip";
			load = <0x84000000>;
			entry = <0x84000000>;
                        hash@1 {
                                algo = "crc32";
                        };
			hash@2 {
				algo = "sha1";
			};
		};

		fdt@1 {
			description = "Flattened dragonboard Device Tree blob";
			data = /incbin/("./dtbs/apq8016-sbc.dtb");
			type = "flat_dt";
			arch = "arm64";
			compression = "none";
                        load = <0x83000000>;
                        entry = <0x83000000>;
			hash@1 {
				algo = "crc32";
			};
			hash@2 {
				algo = "sha1";
			};
		};
	};

	configurations {
		default = "config@1";
		config@1 {
			description = "Boot Linux kernel with FDT blob";
			kernel = "kernel@1";
                        ramdisk = "ramdisk@1";
                        fdt = "fdt@1";
                        signature@1 {
                                algo = "sha256,rsa2048";
                                key-name-hint = "ondra";
                                sign-images = "kernel","ramdisk","fdt";
                        };
		};
	};
};
```
